## yocto/meta-eco-core/conf/distro/eco.conf
```bitbake
require conf/distro/poky.conf
DISTRO = "eco"
DISTRO_NAME = "ECO Music OS"
DISTRO_VERSION = "0.1.0-dev"
INIT_MANAGER = "systemd"
DISTRO_FEATURES:append = " wayland opengl alsa pam systemd"
DISTRO_FEATURES:remove = "x11 pulseaudio"
VIRTUAL-RUNTIME_dev_manager = "udev"
VIRTUAL-RUNTIME_login_manager = "shadow-base"
# The appliance owns one audio session; no competing system/user daemons.
PACKAGECONFIG:pn-pipewire = "alsa udev libusb volume systemd wireplumber pipewire-alsa pipewire-jack pulseaudio"
SYSTEMD_AUTO_ENABLE:pn-wireplumber = "disable"
PACKAGECONFIG:append:pn-weston = " shell-kiosk"
PACKAGECONFIG:append:pn-weston-init = " no-idle-timeout"
```
